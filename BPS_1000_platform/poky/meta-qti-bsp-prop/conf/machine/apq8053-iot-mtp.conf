## BPS_1000_platform/poky/meta-qti-bsp-prop/conf/machine/apq8053-iot-mtp.conf
```bitbake
#@TYPE: Machine
#@NAME: APQ8053-IOT-MTP
#@DESCRIPTION: Machine configuration for QTI IOT MTP with APQ8053

require ${COREBASE}/meta-qti-bsp/conf/machine/apq8053-iot-mtp.conf

VARIANT ?= "HY11"
```

## BPS_1000_platform/poky/meta-qti-bsp-prop/conf/machine/sdxhedgehog.conf
```bitbake
#@TYPE: Machine
#@NAME: SDXHEDGEHOG
#@DESCRIPTION: Machine configuration for QTI SDXHEDGEHOG

require ${COREBASE}/meta-qti-bsp/conf/machine/sdxhedgehog.conf

VARIANT ?= "HY11"

# Pull in the security flags overrides for prop packages
require ${COREBASE}/meta-qti-bsp-prop/conf/distro/include/security_flags.inc
```

## BPS_1000_platform/poky/meta-qti-bsp/conf/distro/msm-user.conf
```bitbake
###############################################################################################
#@TYPE: Distribution
#@NAME: MSM-USER
#@DESCRIPTION: QTI Linux Distribution for MSM targets with production orientation (glibc based)
################################################################################################

require conf/distro/include/msm.inc

# DISTRO CONFIGURATION
DISTRO_NAME = "msm-user"
DISTRO_VERSION = "${BUILDNAME}"
VIRTUAL-RUNTIME_dev_manager ?= "busybox-mdev"

# Add msm-user to distro overrides
DISTROOVERRIDES = "msm:msm-user"

# Basic distribution features
DISTRO_FEATURES += "sysvinit eabi ipv6 ipv4 largefile thumb-interwork xattr ${MICRO_GOLD} ${DISTRO_FEATURES_LIBC}"

# MSMs are emmc based targets
DISTRO_FEATURES += "emmc-boot"

# Enable performance features
PERF_BUILD = "1"

# Build optimization to disable debugging features, mainly for production images.
USER_BUILD = "1"

# TEMP FIX: retain existing directory structure for base product image.
DEPLOY_NAME ?= "${@base_contains('PRODUCT', 'base', '${MACHINE}', '${MACHINE}-${PRODUCT}', d)}-user"
DEPLOY_DIR_IMAGE = "${DEPLOY_DIR}/images/${DEPLOY_NAME}"
```

## BPS_1000_platform/poky/meta-qti-bsp/conf/machine/apq8053-compact.conf
```bitbake
#@TYPE: Machine
#@NAME: APQ8053-COMPACT
#@DESCRIPTION: Machine configuration for QTI MTP with APQ8053

require conf/machine/include/apq8053.inc

DEFAULTTUNE = "armv7a-neon"

PREFERRED_PROVIDER_virtual/kernel = "lib64-linux-quic"

KERNEL_IMAGETYPE = "Image.gz-dtb"
KERNEL_DTS_NAME = "msm8953"
KERNEL_BASE = "0x80000000"
KERNEL_TAGS_OFFSET = "0x81900000"
KERNEL_DEFCONFIG = "msmcortex_defconfig"
KERNEL_CMD_PARAMS = "noinitrd ro console=ttyHSL0,115200,n8 androidboot.hardware=qcom ehci-hcd.park=3 msm_rtb.filter=0x37 lpm_levels.sleep_disabled=1 rootwait androidboot.bootdevice=7824900.sdhci"

# Perf kernel configs
KERNEL_PERF_IMAGETYPE = "Image-dtb"
KERNEL_PERF_DEFCONFIG = "apq8053_IoE-perf_defconfig"
KERNEL_PERF_CMD_PARAMS = "noinitrd ro androidboot.hardware=qcom ehci-hcd.park=3 msm_rtb.filter=0x37 lpm_levels.sleep_disabled=1 rootwait androidboot.bootdevice=7824900.sdhci"

# readonly-rootfs
DISTRO_FEATURES_append = " ro-rootfs"

# Disable journalling for RO rootfs. Set the block size to 1024.
IMAGE_EXT4_EXTRA_OPTIONS = "${@base_contains('DISTRO_FEATURES','ro-rootfs',' -J -b 1024 ','',d)}"

# Force multilib to aarch64 to get arm64 toolchain to build kernel
MULTILIBS = "multilib:lib64"
DEFAULTTUNE_virtclass-multilib-lib64 = "aarch64"
TARGET_VENDOR_virtclass-multilib-lib64="-oe"

BBMASK .= "|.*/*/recipes-security/selinux/selinux-config*"
BBMASK .= "|.*/*/recipes-security/selinux/refpolicy-mls*"
BBMASK .= "|.*/*/recipes-security/setools/setools*"
```

## BPS_1000_platform/poky/meta-qti-bsp/conf/machine/include/mdm9607.inc
```bitbake
BASEMACHINE ?= "mdm9607"
require conf/machine/include/basemachine.inc

SOC_FAMILY ?= "mdm9x07"
include conf/machine/include/soc-family.inc

# Uncomment the following line to enable the hard floating point abi. Note that
# this breaks some binary libraries and 3D (neither of which ship with
# meta-yocto). For maximum compatibility, leave this disabled.
#DEFAULTTUNE ?= "cortexa8hf-neon"

require conf/machine/include/tune-cortexa8.inc

BBMASK = ".*/*/recipes-kernel/linux-msm-4.4"
BBMASK .= "|.*/*/recipes-security/libselinux/"

MACHINE_DISPLAY_WIDTH_PIXELS ?= "480"
MACHINE_DISPLAY_HEIGHT_PIXELS ?= "640"

SERIAL_CONSOLE ?= "115200 ttyHSL0"

DISTRO ?= "mdm"

MACHINE_FEATURES += "kernel26 keyboard"

PAGE_SIZE ?= '4096'
PAGE_SIZE_2K ?= '2048'

# Max supported inodes
EXTRA_IMAGECMD ?= "-N 2048"

#UBINIZE Args
UBINIZE_ARGS ?= "-m 4096 -p 256KiB -s 4096"
UBINIZE_ARGS_2K ?= "-m 2048 -p 131072 -s 2048"
#MKUBIFS Arg
MKUBIFS_ARGS ?= "-m 4096 -e 253952 -c 2146 -F"
MKUBIFS_ARGS_2K ?= "-m 2048 -e 126976 -c 2146 -F"
#Volume sizes
SYSTEM_VOLUME_SIZE ?= "74MiB"
SYSTEM_VOLUME_SIZE_2K ?= "57MiB"
CACHE_VOLUME_SIZE ?= "37MiB"
CACHE_VOLUME_SIZE_2K ?= "1MiB"
```

## BPS_1000_platform/poky/meta-qti-bsp/conf/machine/mdm9650-ccard.conf
```bitbake
#@TYPE: Machine
#@NAME: MDM9650-CCARD
#@DESCRIPTION: Machine configuration for MDM9650 CCARD with 2K NAND

require conf/machine/mdm9650.conf

PREFERRED_PROVIDER_virtual/kernel ?= "linux-quic"

KERNEL_IMAGETYPE = "zImage"
KERNEL_DTS_NAME = "mdm9650"
KERNEL_BASE = "0x80000000"
KERNEL_TAGS_OFFSET = "0x82000000"
KERNEL_DEFCONFIG = "mdm_defconfig"
KERNEL_PERF_DEFCONFIG = "mdm-perf_defconfig"
KERNEL_CMD_PARAMS = "noinitrd rw console=ttyHSL0,115200,n8 androidboot.hardware=qcom ehci-hcd.park=3 msm_rtb.filter=0x37 lpm_levels.sleep_disabled=1 earlycon=msm_hsl_uart,0x78b1000"

# Change images for 2K NAND
PAGE_SIZE = '2048'
UBINIZE_ARGS = "-m 2048 -p 128KiB -s 2048"
MKUBIFS_ARGS = "-m 2048 -e 126976 -c 2047 -F"
SYSTEM_VOLUME_SIZE = "200MiB"
SYSTEM_SIZE_EXT4 = "200000000"
```
